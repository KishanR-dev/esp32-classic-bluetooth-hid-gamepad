## sdkconfig.defaults
```kconfig
# Target
CONFIG_IDF_TARGET="esp32"

# Bluetooth controller / host
CONFIG_BT_ENABLED=y
CONFIG_BTDM_CTRL_MODE_BTDM=y
CONFIG_BTDM_CTRL_BR_EDR_SCO_DATA_PATH_EFF=1
CONFIG_BT_BLUEDROID_ENABLED=y

# Prefer Classic-only behavior during this phase (reduce BLE interference)
# Note: exact symbol names can vary by IDF version; adjust via menuconfig if needed.
CONFIG_BTDM_CTRL_MODE_BR_EDR_ONLY=y

# Security / pairing baseline
CONFIG_BT_SSP_ENABLED=y

# Logging (useful while bringing up HID)
CONFIG_LOG_DEFAULT_LEVEL_INFO=y
```
